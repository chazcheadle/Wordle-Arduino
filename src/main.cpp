#include <Arduino.h>
#include <avr/pgmspace.h>
#include <SPI.h>
#include <Adafruit_I2CDevice.h>
#include <Adafruit_GFX.h>
#include <Adafruit_ST7735.h>
#include <Fonts/FreeMonoBold9pt7b.h>

// const char words_list[] PROGMEM = "ABACIABACKABAFTABASEABASHABATEABBEYABBOTABEAMABETSABHORABIDEABLERABODEABORTABOUTABOVEABUSEABUTSABUZZABYSSACHEDACHESACHOOACIDSACINGACMESACORNACRESACRIDACTEDACTORACUTEADAGEADAPTADDEDADDERADDLEADEPTADIEUADMANADMENADMITADOBEADOPTADOREADORNADULTADZESAEGISAEONSAERIEAFFIXAFIREAFOOTAFOULAFTERAGAINAGAPEAGATEAGAVEAGENTAGILEAGINGAGISMAGLOWAGONYAGREEAHEADAIDEDAIDESAILEDAIMEDAIREDAISLEALARMALBUMALDERALERTALGAEALIASALIBIALIENALIGNALIKEALINEALIVEALLAYALLEYALLOTALLOWALLOYALOESALOFTALOHAALONEALONGALOOFALOUDALPHAALTARALTERALTHOALTOSALUMSAMASSAMAZEAMBERAMBLEAMEBAAMEERAMENDAMIGOAMINOAMIRSAMISSAMITYAMONGAMOURAMPLEAMPLYAMPULAMUCKAMUSEANGELANGERANGLEANGRYANGSTANIMEANIONANISEANKHSANKLEANNEXANNOYANNULANODEANONSANTEDANTESANTICANTISANVILAORTAAPACEAPARTAPHIDAPINGAPPALAPPLEAPPLYAPRONAPSESAPTERAPTLYAQUAEAQUASARBORARCEDARDORAREASARENAARGONARGOTARGUEARIASARISEARMEDARMORAROMAAROSEARRAYARROWARSONARTSYASCOTASHEDASHENASHESASIDEASKEDASKEWASPENASPICASSAYASSESASSETASTERASTIRATLASATOLLATOMSATONEATRIAATTARATTICAUDIOAUDITAUGERAUGHTAUGURAUNTSAURAEAURALAURASAUTOSAVAILAVASTAVERSAVERTAVIANAVOIDAVOWSAWAITAWAKEAWARDAWAREAWASHAWFULAWINGAWOKEAXIALAXINGAXIOMAXLESAXONSAZUREBAAEDBABELBABESBACKSBACONBADGEBADLYBAGELBAGGYBAILSBAITSBAIZEBAKEDBAKERBAKESBALDSBALEDBALESBALKSBALKYBALLSBALMSBALMYBALSABANALBANDSBANDYBANESBANGSBANJOBANKSBANNSBARBSBARDSBAREDBARERBARESBARFSBARGEBARKSBARNSBARONBASALBASEDBASERBASESBASICBASILBASINBASISBASKSBASSIBASSOBASTEBATCHBATEDBATESBATHEBATHSBATIKBATONBATTYBAUDSBAWDYBAWLSBAYEDBAYOUBEACHBEADSBEADYBEAKSBEAMSBEANSBEARDBEARSBEASTBEATSBEAUSBEAUXBEBOPBECKSBEECHBEEFSBEEFYBEEPSBEERSBEETSBEFITBEFOGBEGANBEGATBEGETBEGINBEGOTBEGUNBEIGEBEINGBELAYBELCHBELIEBELLEBELLSBELLYBELOWBELTSBENCHBENDSBENTSBERETBERGSBERMSBERRYBERTHBERYLBESETBESOMBESOTBESTSBETASBEVELBIBLEBICEPBIDDYBIDEDBIDESBIDETBIERSBIGHTBIGOTBIKEDBIKERBIKESBILGEBILKSBILLSBILLYBIMBOBINDSBINGEBINGOBIPEDBIRCHBIRDSBIRTHBISONBITCHBITESBLABSBLACKBLADEBLAMEBLANDBLANKBLAREBLASTBLAZEBLEAKBLEATBLEEDBLEEPBLENDBLENTBLESSBLESTBLIMPBLINDBLINGBLINKBLIPSBLISSBLITZBLOATBLOBSBLOCKBLOCSBLOGSBLONDBLOODBLOOMBLOTSBLOWNBLOWSBLUEDBLUERBLUESBLUFFBLUNTBLURBBLURSBLURTBLUSHBOARDBOARSBOASTBOATSBOBBYBODEDBODESBOGEYBOGGYBOGIEBOGUSBOILSBOLASBOLESBOLLSBOLTSBOMBSBONDSBONEDBONERBONESBONEYBONGOBONGSBONNYBONUSBOOBSBOOBYBOOEDBOOKSBOOMSBOONSBOORSBOOSTBOOTHBOOTSBOOTYBOOZEBOOZYBORAXBOREDBORERBORESBORNEBORONBOSOMBOSSYBOSUNBOTCHBOUGHBOUNDBOUTSBOWEDBOWELBOWERBOWLSBOXEDBOXERBOXESBOZOSBRACEBRACTBRADSBRAGSBRAIDBRAINBRAKEBRANDBRASHBRASSBRATSBRAVEBRAVOBRAWLBRAWNBRAYSBREADBREAKBREEDBREWSBRIARBRIBEBRICKBRIDEBRIEFBRIERBRIGSBRIMSBRINEBRINGBRINKBRINYBRISKBROADBROILBROKEBROODBROOKBROOMBROTHBROWNBROWSBRUINBRUNTBRUSHBRUSKBRUTEBUCKSBUDDYBUDGEBUFFSBUGGYBUGLEBUILDBUILTBULBSBULGEBULGYBULKSBULKYBULLSBULLYBUMPSBUMPYBUNCHBUNGSBUNKSBUNNYBUNTSBUOYSBURGSBURKABURLYBURNSBURNTBURPSBURROBURRSBURSTBUSBYBUSEDBUSESBUSHYBUSTSBUTCHBUTTEBUTTSBUXOMBUYERBYLAWBYTESBYWAYCABALCABBYCABINCABLECACAOCACHECACTICADDYCADETCADGECADRECAGEDCAGESCAGEYCAIRNCAKEDCAKESCALFSCALIFCALKSCALLSCALMSCALVECALYXCAMELCAMEOCAMPSCAMPYCANALCANDYCANEDCANESCANNYCANOECANONCANTOCANTSCAPEDCAPERCAPESCAPONCARATCARBSCARDSCAREDCARESCARETCARGOCAROLCAROMCARPICARPSCARRYCARTSCARVECASEDCASESCASKSCASTECASTSCATCHCATERCATTYCAULKCAUSECAVEDCAVESCAVILCAWEDCEASECEDARCEDEDCEDESCELLICELLOCELLSCENTSCHAFECHAFFCHAINCHAIRCHALKCHAMPCHANTCHAOSCHAPSCHAPTCHARMCHARSCHARTCHARYCHASECHASMCHATSCHEAPCHEATCHECKCHEEKCHEEPCHEERCHEFSCHESSCHESTCHEWSCHEWYCHICKCHIDECHIEFCHILDCHILECHILICHILLCHIMECHIMPCHINACHINKCHINOCHINSCHIPSCHIRPCHITSCHIVECHOCKCHOIRCHOKECHOMPCHOPSCHORDCHORECHOSECHOWSCHUCKCHUGSCHUMPCHUMSCHUNKCHURLCHURNCHUTECIDERCIGARCILIACINCHCIRCACITEDCITESCIVETCIVICCIVILCLACKCLAIMCLAMPCLAMSCLANGCLANKCLANSCLAPSCLASHCLASPCLASSCLAWSCLEANCLEARCLEATCLEFSCLEFTCLERKCLEWSCLICKCLIFFCLIMBCLIMECLINGCLINKCLIPSCLIPTCLITSCLOAKCLOCKCLODSCLOGSCLOMPCLONECLOPSCLOSECLOTHCLOTSCLOUDCLOUTCLOVECLOWNCLOYSCLUBSCLUCKCLUEDCLUESCLUMPCLUNGCLUNKCOACHCOALSCOASTCOATSCOBRACOCCICOCKSCOCKYCOCOACODASCODEDCODESCODEXCOEDSCOIFSCOILSCOINSCOKEDCOKESCOLASCOLDSCOLICCOLONCOLORCOLTSCOMASCOMBOCOMBSCOMERCOMESCOMETCOMFYCOMICCOMMACONCHCONDOCONESCONGACONICCONKSCOOEDCOOKSCOOKYCOOLSCOONSCOOPSCOOTSCOPEDCOPESCOPRACOPSECORALCORDSCOREDCORESCORKSCORMSCORNSCORNYCORPSCOSTSCOTESCOUCHCOUGHCOULDCOUNTCOUPECOUPSCOURTCOVENCOVERCOVESCOVETCOVEYCOWEDCOWERCOWLSCOYERCOYLYCOZENCRABSCRACKCRAFTCRAGSCRAMPCRAMSCRANECRANKCRAPECRAPSCRASHCRASSCRATECRAVECRAWLCRAWSCRAZECRAZYCREAKCREAMCREDOCREEDCREEKCREELCREEPCREPECREPTCRESSCRESTCREWSCRIBSCRICKCRIEDCRIERCRIESCRIMECRIMPCRISPCROAKCROCICROCKCRONECRONYCROOKCROONCROPSCROSSCROUPCROWDCROWNCROWSCRUDECRUELCRUETCRUMBCRUSHCRUSTCRYPTCUBEDCUBESCUBICCUBITCUFFSCUINGCULLSCULTSCUMINCUNTSCUPIDCURBSCURDSCUREDCURERCURESCURIECURIOCURLSCURLYCURRYCURSECURSTCURVECURVYCUSHYCUSPSCUTERCUTUPCYCLECYNICCYSTSCZARSDACHADADDYDADOSDAFFYDAILYDAIRYDAISYDALESDALLYDAMESDAMNSDAMPSDANCEDANDYDAREDDARESDARNSDARTSDATEDDATESDATUMDAUBSDAUNTDAVITDAWNSDAZEDDAZESDEALSDEALTDEANSDEARSDEATHDEBARDEBITDEBTSDEBUGDEBUTDECAFDECALDECAYDECKSDECORDECOYDECRYDEEDSDEEMSDEEPSDEERSDEFERDEICEDEIFYDEIGNDEISMDEITYDELAYDELISDELLSDELTADELVEDEMONDEMOSDEMURDENIMDENSEDENTSDEPOTDEPTHDERBYDESKSDETERDETOXDEUCEDEVILDHOTIDIALSDIARYDICEDDICESDICEYDICKSDICKYDICTADIETSDIGITDIKEDDIKESDILLSDILLYDIMERDIMESDIMLYDINEDDINERDINESDINGODINGSDINGYDINKYDIODEDIRERDIRGEDIRKSDIRTYDISCODISCSDISKSDITCHDITTODITTYDIVANDIVASDIVEDDIVERDIVESDIVOTDIVVYDIZZYDJINNDOCKSDODGEDODOSDOERSDOFFSDOGGYDOGIEDOGMADOILYDOINGDOLEDDOLESDOLLSDOLLYDOLTSDOMEDDOMESDONORDONUTDOOMSDOORSDOPEDDOPESDOPEYDORKSDORKYDORMSDOSEDDOSESDOTEDDOTESDOTTYDOUBTDOUGHDOUSEDOVESDOWDYDOWELDOWNSDOWNYDOWRYDOWSEDOYENDOZEDDOZENDOZESDRABSDRAFTDRAGSDRAINDRAKEDRAMADRAMSDRANKDRAPEDRAWLDRAWNDRAWSDRAYSDREADDREAMDREGSDRESSDRIEDDRIERDRIESDRIFTDRILLDRILYDRINKDRIPSDRIVEDROLLDRONEDROOLDROOPDROPSDROSSDROVEDROWNDRUBSDRUGSDRUIDDRUMSDRUNKDRYADDRYERDRYLYDUCALDUCATDUCHYDUCKSDUCTSDUDEDDUDESDUELSDUETSDUKESDULLSDULLYDUMMYDUMPSDUMPYDUNCEDUNESDUNGSDUNKSDUNNODUPEDDUPESDUSKYDUSTSDUSTYDUVETDWARFDWEEBDWELLDWELTDYERSDYINGDYKESEAGEREAGLEEARLSEARLYEARNSEARTHEASEDEASELEASESEATENEATEREAVESEBBEDEBONYECHOSEDEMAEDGEDEDGEREDGESEDICTEDIFYEDITSEERIEEGGEDEGRETEIDEREIGHTEJECTEKINGELATEELBOWELDERELECTELEGYELFINELIDEELITEELOPEELUDEELVESEMAILEMBEDEMBEREMCEEEMENDEMERYEMIRSEMITSEMOJIEMOTEEMPTYENACTENDEDENDOWENDUEENEMAENEMYENJOYENNUIENROLENSUEENTERENTRYENUREENVOYEPICSEPOCHEPOXYEQUALEQUIPERASEERECTERODEERREDERRORERUPTESSAYESTERETHERETHICETHOSEUROSEVADEEVENSEVENTEVERYEVICTEVILSEVOKEEWERSEXACTEXALTEXAMSEXCELEXECSEXERTEXILEEXISTEXITSEXPELEXPOSEXTOLEXTRAEXUDEEXULTEYINGEYRIEFABLEFACEDFACESFACETFACTSFADEDFADESFAGOTFAILSFAINTFAIRSFAIRYFAITHFAKEDFAKERFAKESFAKIRFALLSFALSEFAMEDFANCYFANGSFANNYFARCEFAREDFARESFARMSFARTSFASTSFATALFATEDFATESFATTYFAULTFAUNAFAUNSFAVORFAWNSFAXEDFAXESFAZEDFAZESFEARSFEASTFEATSFECALFECESFEEDSFEELSFEIGNFEINTFELLSFELONFELTSFEMURFENCEFENDSFERALFERNSFERRYFESTSFETALFETCHFETEDFETIDFETUSFEUDSFEVERFEWERFEZESFIATSFIBERFICHEFIEFSFIELDFIENDFIERYFIFESFIFTHFIFTYFIGHTFILCHFILEDFILESFILETFILLSFILLYFILMSFILMYFILTHFINALFINCHFINDSFINEDFINERFINESFINISFINKSFINNYFIORDFIREDFIRESFIRMSFIRSTFIRTHFISHYFISTSFITLYFIVERFIVESFIXEDFIXERFIXESFIZZYFJORDFLACKFLAGSFLAILFLAIRFLAKEFLAKYFLAMEFLANKFLAPSFLAREFLASHFLASKFLATSFLAWSFLAYSFLEASFLECKFLEESFLEETFLESHFLICKFLIEDFLIERFLIESFLINGFLINTFLIPSFLIRTFLITSFLOATFLOCKFLOESFLOGSFLOODFLOORFLOPSFLORAFLOSSFLOURFLOUTFLOWNFLOWSFLUBSFLUESFLUFFFLUIDFLUKEFLUKYFLUMEFLUNGFLUNKFLUSHFLUTEFLYBYFLYERFOALSFOAMSFOAMYFOCALFOCUSFOGEYFOGGYFOILSFOISTFOLDSFOLIOFOLKSFOLLYFONDUFONTSFOODSFOOLSFOOTSFORAYFORCEFORDSFORESFORGEFORGOFORKSFORMSFORTEFORTHFORTSFORTYFORUMFOULSFOUNDFOUNTFOURSFOWLSFOXEDFOXESFOYERFRACKFRAILFRAMEFRANCFRANKFRATSFRAUDFRAYSFREAKFREEDFREERFREESFRESHFRETSFRIARFRIEDFRIERFRIESFRILLFRISKFRIZZFROCKFROGSFRONDFRONTFROSTFROTHFROWNFROZEFRUITFRUMPFRYERFUCKSFUDGEFUELSFUGUEFULLSFULLYFUMEDFUMESFUNDSFUNGIFUNKSFUNKYFUNNYFURLSFURORFURRYFURZEFUSEDFUSESFUSSYFUSTYFUTONFUZEDFUZESFUZZYGABBYGABLEGAFFEGAFFSGAGEDGAGESGAILYGAINSGAITSGALASGALESGALLSGAMEDGAMERGAMESGAMEYGAMINGAMMAGAMUTGANGSGAPEDGAPESGARBSGASESGASPSGASSYGATEDGATESGAUDYGAUGEGAUNTGAUZEGAUZYGAVELGAWKSGAWKYGAYERGAYLYGAZEDGAZERGAZESGEARSGECKOGEEKSGEEKYGEESEGELDSGELIDGENESGENIEGENIIGENREGENTSGENUSGEODEGERMSGETUPGHOSTGHOULGIANTGIBEDGIBESGIDDYGIFTSGILDSGILLSGILTSGIMMEGIMPYGIPSYGIRDSGIRLSGIRTHGIRTSGISMOGIVENGIVESGIZMOGLADEGLADSGLANDGLAREGLASSGLAZEGLEAMGLEANGLENSGLIDEGLINTGLITZGLOATGLOBEGLOBSGLOOMGLORYGLOSSGLOVEGLOWSGLUEDGLUESGLUEYGLUTSGLYPHGNARLGNASHGNATSGNAWNGNAWSGNOMEGOADSGOALSGOATSGODLYGOFERGOINGGOLDSGOLFSGOLLYGONADGONERGONGSGONNAGOODSGOODYGOOEYGOOFSGOOFYGOOKSGOONSGOOSEGOREDGORESGORGEGORSEGOTTAGOUGEGOURDGOUTYGOWNSGRABSGRACEGRADEGRADSGRAFTGRAILGRAINGRAMSGRANDGRANTGRAPEGRAPHGRASPGRASSGRATEGRAVEGRAVYGRAYSGRAZEGREATGREBEGREEDGREENGREETGREYSGRIDSGRIEFGRILLGRIMEGRIMYGRINDGRINSGRIPEGRIPSGRISTGRITSGROANGROINGROOMGROPEGROSSGROUPGROUTGROVEGROWLGROWNGROWSGRUBSGRUELGRUFFGRUNTGUANOGUARDGUAVAGUESSGUESTGUIDEGUILDGUILEGUILTGUISEGULAGGULCHGULFSGULLSGULLYGULPSGUMBOGUMMYGUNNYGUPPYGURUSGUSHYGUSTOGUSTSGUSTYGUTSYGUYEDGYBEDGYBESGYPSYGYROSHABITHACKSHAFTSHAIKUHAILSHAIRSHAIRYHAKESHALEDHALERHALESHALLSHALONHALOSHALTSHALVEHANDSHANDYHANGSHANKSHANKYHAPPYHARDYHAREDHAREMHARESHARKSHARMSHARPSHARPYHARRYHARSHHARTSHASPSHASTEHASTYHATCHHATEDHATERHATESHAULSHAUNTHAVENHAVESHAVOCHAWEDHAWKSHAYEDHAZEDHAZELHAZESHEADSHEADYHEALSHEAPSHEARDHEARSHEARTHEATHHEATSHEAVEHEAVYHEDGEHEEDSHEELSHEFTSHEFTYHEIRSHEISTHELIXHELLOHELMSHELOTHELPSHENCEHENNAHERBSHERDSHERONHEROSHERTZHEWEDHEWERHEXEDHEXESHICKSHIDEDHIDESHIGHSHIKEDHIKERHIKESHILLSHILLYHILTSHINDSHINGEHINTSHIPPOHIPPYHIREDHIRESHITCHHIVEDHIVESHOAGYHOARDHOARYHOBBYHOBOSHOCKSHOGANHOISTHOKEYHOKUMHOLDSHOLEDHOLESHOLLYHOMEDHOMERHOMESHOMEYHOMIEHONEDHONESHONEYHONKSHONORHOOCHHOODSHOOEYHOOFSHOOKSHOOKYHOOPSHOOTSHOPEDHOPESHORDEHORNSHORNYHORSEHORSYHOSEDHOSESHOSTSHOTELHOTLYHOUNDHOURSHOUSEHOVELHOVERHOWDYHOWLSHUBBYHUFFSHUFFYHUGERHULASHULKSHULLSHUMANHUMIDHUMORHUMPSHUMUSHUNCHHUNKSHUNTSHURLSHURRYHURTSHUSKSHUSKYHUSSYHUTCHHYDRAHYENAHYINGHYMENHYMNSHYPEDHYPERHYPESHYPOSIAMBSICIERICILYICINGICONSIDEALIDEASIDIOMIDIOTIDLEDIDLERIDLESIDOLSIDYLLIDYLSIGLOOIKONSIMAGEIMAMSIMBEDIMBUEIMPELIMPLYINANEINAPTINBOXINCURINDEXINDUEINEPTINERTINFERINFIXINGOTINKEDINLAYINLETINNERINPUTINSETINTERINUREIOTASIRATEIRKEDIRONSIRONYISLESISLETISSUEITCHYITEMSIVIESIVORYJABOTJACKSJADEDJADESJAILSJAMBSJAPANJAPEDJAPESJAUNTJAWEDJAZZYJEANSJEEPSJEERSJEHADJELLOJELLSJELLYJERKSJERKYJESTSJETTYJEWELJIBEDJIBESJIFFYJIHADJILTSJIMMYJINNIJINNSJIVEDJIVESJOCKSJOHNSJOINSJOINTJOISTJOKEDJOKERJOKESJOLLYJOLTSJOULEJOUSTJOWLSJOYEDJUDGEJUICEJUICYJULEPJUMBOJUMPSJUMPYJUNCOJUNKSJUNKYJUNTAJURORKABOBKAPOKKAPUTKARATKARMAKAYAKKAZOOKEBABKEBOBKEELSKEENSKEEPSKETCHKEYEDKHAKIKHANSKICKSKICKYKIDDOKIDDYKILLSKILNSKILOSKILTSKINDAKINDSKINGSKINKSKINKYKIOSKKITEDKITESKITTYKIWISKLUTZKNACKKNAVEKNEADKNEEDKNEELKNEESKNELLKNELTKNIFEKNITSKNOBSKNOCKKNOLLKNOTSKNOWNKNOWSKOALAKOOKSKOOKYKOPEKKRONEKUDOSKUDZULABELLABIALABORLACEDLACESLACKSLADEDLADENLADESLADLELAGERLAIRSLAITYLAKESLAMASLAMBSLAMEDLAMERLAMESLAMPSLANCELANDSLANESLANKYLAPELLAPSELARCHLARDSLARGELARGOLARKSLARVALASERLASSOLASTSLATCHLATERLATEXLATHELATHSLATTELAUDSLAUGHLAWNSLAXERLAXLYLAYERLAZEDLAZESLEACHLEADSLEAFSLEAFYLEAKSLEAKYLEANSLEAPSLEAPTLEARNLEASELEASHLEASTLEAVELEDGELEECHLEEKSLEERSLEERYLEFTSLEFTYLEGALLEGGYLEGITLEMMALEMMELEMONLEMURLENDSLEPERLETUPLEVEELEVELLEVERLIARSLIBELLICITLICKSLIEGELIENSLIFERLIFTSLIGHTLIKEDLIKENLIKERLIKESLILACLILTSLIMBOLIMBSLIMEDLIMESLIMITLIMNSLIMOSLIMPSLINEDLINENLINERLINESLINGOLINKSLIONSLIPIDLIRASLISLELISPSLISTSLITERLITHELIVEDLIVENLIVERLIVESLIVIDLLAMALLANOLOADSLOAFSLOAMYLOANSLOATHLOBBYLOBEDLOBESLOCALLOCKSLOCUSLODESLODGELOFTSLOFTYLOGESLOGICLOGINLOGONLOGOSLOINSLOLLSLONERLONGSLOOKSLOOMSLOONSLOONYLOOPSLOOPYLOOSELOOTSLOPEDLOPESLORDSLORRYLOSERLOSESLOTTOLOTUSLOUSELOUSYLOUTSLOVEDLOVERLOVESLOWEDLOWERLOWLYLOXESLOYALLUAUSLUBEDLUBESLUCIDLUCKSLUCKYLUCRELULLSLUMPSLUMPYLUNARLUNCHLUNGELUNGSLUPINLUPUSLURCHLUREDLURESLURIDLURKSLUSTSLUSTYLUTESLYINGLYMPHLYNCHLYRESLYRICMACAWMACEDMACESMACHOMACROMADAMMADLYMAGICMAGMAMAIDSMAILSMAIMSMAINSMAIZEMAJORMAKERMAKESMALESMALLSMALTSMAMASMAMBOMAMMAMANESMANGAMANGEMANGOMANGYMANIAMANICMANLYMANNAMANORMANSEMAPLEMARCHMARESMARIAMARKSMARRYMARSHMARTSMASKSMASONMASTSMATCHMATEDMATESMATTEMATTSMATZOMAULSMAUVEMAVENMAVINMAXEDMAXESMAXIMMAYBEMAYORMAZESMEALSMEALYMEANSMEANTMEATSMEATYMECCAMEDALMEDIAMEDICMEETSMELDSMELONMELTSMEMESMEMOSMENDSMENUSMEOWSMERCYMERESMERGEMERITMERRYMESASMESSYMETALMETEDMETERMETESMETROMEWEDMEWLSMIAOWMICRAMIDDYMIDGEMIDSTMIENSMIFFSMIGHTMIKEDMIKESMILCHMILERMILESMILFSMILKSMILKYMILLSMIMEDMIMESMIMICMINCEMINDSMINEDMINERMINESMINIMMINISMINKSMINORMINTSMINTYMINUSMIREDMIRESMIRTHMISDOMISERMISTSMISTYMITERMITESMITTSMIXEDMIXERMIXESMOANSMOATSMOCHAMOCKSMODALMODELMODEMMODESMOGULMOIREMOISTMOLARMOLDSMOLDYMOLESMOLLSMOLTSMOMMAMOMMYMONEYMONKSMONTHMOOCHMOODSMOODYMOOEDMOONSMOORSMOOSEMOOTSMOPEDMOPESMORALMORAYMORESMORNSMORONMOSEYMOSSYMOTELMOTESMOTHSMOTIFMOTORMOTTOMOUNDMOUNTMOURNMOUSEMOUSYMOUTHMOVEDMOVERMOVESMOVIEMOWEDMOWERMUCKSMUCKYMUCUSMUDDYMUFFSMUFTIMUGGYMULCHMULESMULLSMULTIMUMMYMUMPSMUNCHMURALMURKSMURKYMUSEDMUSESMUSHYMUSICMUSKYMUSSYMUSTSMUSTYMUTEDMUTERMUTESMUTTSMYNAHMYNASMYRRHMYTHSNABOBNACHONACRENADIRNAIADNAILSNAIVENAKEDNAMEDNAMESNANNYNAPESNAPPYNARCSNARKSNASALNASTYNATALNATTYNAVALNAVELNAVESNEARSNEATHNECKSNEEDSNEEDYNEIGHNERDSNERDYNERVENERVYNESTSNEVERNEWELNEWERNEWLYNEWSYNEWTSNEXUSNICERNICHENICKSNIECENIFTYNIGGANIGHTNIMBININESNINJANINNYNINTHNIPPYNITERNITESNIXEDNIXESNOBLENOBLYNODALNODDYNODESNOELSNOISENOISYNOMADNONCENOOKSNOOSENORMSNORTHNOSEDNOSESNOSEYNOTCHNOTEDNOTESNOUNSNOVAENOVASNOVELNOWAYNUDERNUDESNUDGENUKEDNUKESNULLSNUMBSNURSENUTTYNYLONNYMPHOAKENOAKUMOAREDOASESOASISOATENOATHSOBESEOBEYSOBITSOBOESOCCUROCEANOCHEROCHREOCTALOCTETODDERODDLYODIUMODORSOFFALOFFEDOFFEROFTENOGLEDOGLESOGRESOILEDOINKSOKAYSOKRASOLDENOLDEROLDIEOLIVEOMEGAOMENSOMITSONIONONSETOOZEDOOZESOPALSOPENSOPERAOPINEOPIUMOPTEDOPTICORALSORATEORBITORDERORGANOSIEROTHEROTTEROUGHTOUNCEOUSTSOUTDOOUTEDOUTEROUTGOOVALSOVARYOVENSOVERSOVERTOVOIDOVULEOWINGOWLETOWNEDOWNEROXBOWOXIDEOZONEPACEDPACESPACKSPACTSPADDYPADREPAEANPAGANPAGEDPAGERPAGESPAILSPAINSPAINTPAIRSPALEDPALERPALESPALLSPALMSPALMYPALSYPANDAPANELPANESPANGSPANICPANSYPANTSPANTYPAPALPAPASPAPAWPAPERPARCHPAREDPARESPARKAPARKSPARRYPARSEPARTSPARTYPASHAPASTAPASTEPASTSPASTYPATCHPATESPATHSPATIOPATSYPATTYPAUSEPAVEDPAVESPAWEDPAWLSPAWNSPAYEDPAYEEPAYERPEACEPEACHPEAKSPEALSPEARLPEARSPEASEPECANPECKSPEDALPEEKSPEELSPEEPSPEERSPEEVEPEKOEPELTSPENALPENCEPENDSPENESPENISPENNYPEONSPEONYPEPPYPERCHPERILPERKSPERKYPERMSPESKYPESOSPESTSPETALPETERPETTYPEWEEPHASEPHIALPHISHPHLOXPHONEPHONYPHOTOPHYLAPIANOPICKSPICKYPIECEPIERSPIETYPIGGYPIGMYPIINGPIKEDPIKERPIKESPILAFPILAUPILAWPILEDPILESPILLSPILOTPIMPSPINCHPINEDPINESPINGSPINKSPINKYPINTOPINTSPINUPPIOUSPIPEDPIPERPIPESPIPITPIQUEPITCHPITHYPITONPIVOTPIXELPIXIEPIZZAPLACEPLAIDPLAINPLAITPLANEPLANKPLANSPLANTPLATEPLAYSPLAZAPLEADPLEASPLEATPLIEDPLIESPLODSPLOPSPLOTSPLOWSPLOYSPLUCKPLUGSPLUMBPLUMEPLUMPPLUMSPLUNKPLUSHPOACHPOCKSPODIAPOEMSPOESYPOETSPOINTPOISEPOKEDPOKERPOKESPOKEYPOLARPOLEDPOLESPOLIOPOLKAPOLLSPOLYPPONDSPONESPOOCHPOOHSPOOLSPOOPSPOPESPOPPAPOPPYPORCHPOREDPORESPORNOPORTSPOSEDPOSERPOSESPOSITPOSSEPOSTSPOTTYPOUCHPOUNDPOURSPOUTSPOWERPOXESPRANKPRATEPRAWNPRAYSPREENPREPSPRESSPREYSPRICEPRICKPRICYPRIDEPRIEDPRIESPRIGSPRIMEPRIMPPRINTPRIORPRISMPRIVYPRIZEPROBEPRODSPROFSPROMOPROMSPRONEPRONGPROOFPROPSPROSEPROSYPROUDPROVEPROWLPROWSPROXYPRUDEPRUNEPSALMPSHAWPSYCHPUBICPUCKSPUDGYPUFFSPUFFYPUKEDPUKESPULLSPULPSPULPYPULSEPUMASPUMPSPUNCHPUNKSPUNTSPUPAEPUPALPUPASPUPILPUPPYPUREEPURERPURGEPURLSPURRSPURSEPUSHYPUSSYPUTTSPUTTYPWNEDPYGMYPYLONPYRESPYXESQUACKQUADSQUAFFQUAILQUAKEQUALMQUARKQUARTQUASHQUASIQUAYSQUEENQUEERQUELLQUERYQUESTQUEUEQUICKQUIDSQUIETQUILLQUILTQUIPSQUIREQUIRKQUITEQUITSQUOITQUOTAQUOTEQUOTHRABBIRABIDRACEDRACERRACESRACKSRADARRADIIRADIORADONRAFTSRAGASRAGEDRAGESRAIDSRAILSRAINSRAINYRAISERAJAHRAJASRAKEDRAKESRALLYRAMPSRANCHRANDYRANGERANGYRANKSRANTSRAPEDRAPESRAPIDRAREDRARERRARESRASPSRASPYRATEDRATESRATIORATTYRAVEDRAVELRAVENRAVESRAWERRAYONRAZEDRAZESRAZORREACHREACTREADSREADYREALMREALSREAMSREAPSREARMREARSREBELREBUSREBUTRECAPRECTARECURREDIDREEDSREEDYREEFSREEKSREELSREEVEREFERREFITREGALREHABREIGNREINSRELAXRELAYRELICREMITRENALRENDSRENEWRENTSREORGREPAYREPELREPLYRERANRERUNRESETRESINRESTSRETCHRETRYREUSEREVELREVUERHEASRHEUMRHINORHYMERICEDRICESRICKSRIDERRIDESRIDGERIFERRIFFSRIFLERIFTSRIGHTRIGIDRIGORRILEDRILESRILLSRIMEDRIMESRINDSRINGSRINKSRINSERIOTSRIPENRIPERRISENRISERRISESRISKSRISKYRITESRITZYRIVALRIVENRIVERRIVETROACHROADSROAMSROANSROARSROASTROBEDROBESROBINROBOTROCKSROCKYRODEOROGERROGUEROILSROLESROLLSROMANROMPSROODSROOFSROOKSROOMSROOMYROOSTROOTSROPEDROPESROSESROSINROTORROUGEROUGHROUNDROUSEROUTEROUTSROVEDROVERROVESROWDYROWEDROWELROWERROYALRUBESRUBLERUDDYRUDERRUFFSRUGBYRUINGRUINSRULEDRULERRULESRUMBARUMMYRUMORRUMPSRUNESRUNGSRUNNYRUNTSRUPEERURALRUSESRUSKSRUSTSRUSTYSABERSABLESABRESACKSSADESSADLYSAFERSAFESSAGASSAGERSAGESSAHIBSAILSSAINTSAITHSALADSALESSALLYSALONSALSASALTSSALTYSALVESALVOSAMBASAMESSANDSSANDYSANERSAPPYSAREESARISSASSYSATAYSATEDSATESSATINSATYRSAUCESAUCYSAUNASAVEDSAVERSAVESSAVORSAVVYSAWEDSAXESSCABSSCADSSCALDSCALESCALPSCALYSCAMPSCAMSSCANSSCANTSCARESCARFSCARSSCARYSCATSSCENESCENTSCHWASCIONSCOFFSCOLDSCONESCOOPSCOOTSCOPESCORESCORNSCOURSCOUTSCOWLSCOWSSCRAMSCRAPSCREWSCRIPSCRODSCRUBSCUBASCUDSSCUFFSCULLSCUMSSCURFSEALSSEAMSSEAMYSEARSSEATSSECTSSEDANSEDGESEEDSSEEDYSEEKSSEEMSSEEPSSEERSSEGUESEIZESELLSSEMENSEMISSENDSSENNASENSESEPALSEPIASEPTASERERSERFSSERGESERUMSERVESERVOSETUPSEVENSEVERSEWEDSEWERSEXEDSEXESSHACKSHADESHADSSHADYSHAFTSHAGSSHAHSSHAKESHAKYSHALESHALLSHALTSHAMESHAMSSHANKSHAPESHARDSHARESHARKSHARPSHAVESHAWLSHEAFSHEARSHEDSSHEENSHEEPSHEERSHEETSHEIKSHELFSHELLSHERDSHIEDSHIESSHIFTSHILLSHIMSSHINESHINSSHINYSHIPSSHIRESHIRKSHIRRSHIRTSHITSSHLEPSHOALSHOCKSHOEDSHOESSHONESHOOKSHOONSHOOSSHOOTSHOPSSHORESHORNSHORTSHOTSSHOUTSHOVESHOWNSHOWSSHOWYSHREDSHREWSHRUBSHRUGSHTIKSHUCKSHUNSSHUNTSHUSHSHUTSSHYERSHYLYSIBYLSICKSSIDEDSIDESSIDLESIEGESIEVESIFTSSIGHSSIGHTSIGMASIGNSSILKSSILKYSILLSSILLYSILOSSILTSSINCESINEWSINGESINGSSINKSSINUSSIREDSIRENSIRESSIRUPSISALSISESSISSYSITARSITEDSITESSIXESSIXTHSIXTYSIZEDSIZERSIZESSKATESKEETSKEINSKEWSSKIDSSKIEDSKIERSKIESSKIFFSKILLSKIMPSKIMSSKINSSKIPSSKIRTSKITSSKULKSKULLSKUNKSKYEDSLABSSLACKSLAGSSLAINSLAKESLAMSSLANGSLANTSLAPSSLASHSLATESLATSSLAVESLAYSSLEDSSLEEKSLEEPSLEETSLEPTSLEWSSLICESLICKSLIDESLIERSLILYSLIMESLIMSSLIMYSLINGSLINKSLIPSSLITSSLOBSSLOESSLOGSSLOOPSLOPESLOPSSLOSHSLOTHSLOTSSLOWSSLUEDSLUESSLUGSSLUMPSLUMSSLUNGSLUNKSLURPSLURSSLUSHSLUTSSLYERSLYLYSMACKSMALLSMARTSMASHSMEARSMELLSMELTSMILESMIRKSMITESMITHSMOCKSMOKESMOKYSMOTESMUTSSNACKSNAFUSNAGSSNAILSNAKESNAKYSNAPSSNARESNARLSNEAKSNEERSNIDESNIFFSNIPESNIPSSNITSSNOBSSNOOPSNOOTSNORESNORTSNOTSSNOUTSNOWSSNOWYSNUBSSNUCKSNUFFSNUGSSOAKSSOAPSSOAPYSOARSSOBERSOCKSSODASSOFASSOFTYSOGGYSOILSSOLARSOLEDSOLESSOLIDSOLOSSOLVESONARSONGSSONICSONNYSOOTHSOOTYSOPPYSORERSORESSORRYSORTASORTSSOUGHSOULSSOUNDSOUPSSOUPYSOURSSOUSESOUTHSOWEDSOWERSPACESPACYSPADESPAKESPAMSSPANKSPANSSPARESPARKSPARSSPASMSPATESPATSSPAWNSPAYSSPEAKSPEARSPECKSPECSSPEEDSPELLSPELTSPENDSPENTSPERMSPEWSSPICESPICYSPIEDSPIELSPIESSPIKESPIKYSPILLSPILTSPINESPINSSPINYSPIRESPITESPITSSPLATSPLAYSPLITSPOILSPOKESPOOFSPOOKSPOOLSPOONSPOORSPORESPORTSPOTSSPOUTSPRATSPRAYSPREESPRIGSPUDSSPUMESPUNKSPURNSPURSSPURTSQUABSQUADSQUATSQUAWSQUIDSTABSSTACKSTAFFSTAGESTAGSSTAIDSTAINSTAIRSTAKESTALESTALKSTALLSTAMPSTANDSTANKSTAPHSTARESTARKSTARSSTARTSTASHSTATESTATSSTAVESTAYSSTEADSTEAKSTEALSTEAMSTEEDSTEELSTEEPSTEERSTEINSTEMSSTENTSTEPSSTERNSTEWSSTICKSTIESSTIFFSTILESTILLSTILTSTINGSTINKSTINTSTIRSSTOATSTOCKSTOICSTOKESTOLESTOMPSTONESTONYSTOODSTOOLSTOOPSTOPSSTORESTORKSTORMSTORYSTOUTSTOVESTOWSSTRAPSTRAWSTRAYSTREPSTREWSTRIPSTROPSTRUMSTRUTSTUBSSTUCKSTUDSSTUDYSTUFFSTUMPSTUNGSTUNKSTUNSSTUNTSTYESSTYLESTYLISUAVESUCKSSUDSYSUEDESUGARSUINGSUITESUITSSULKSSULKYSULLYSUMACSUMPSSUNNYSUNUPSUPERSURERSURFSSURGESURLYSUSHISWABSSWAGSSWAINSWAMISWAMPSWANKSWANSSWAPSSWARDSWARMSWASHSWATHSWATSSWAYSSWEARSWEATSWEEPSWEETSWELLSWEPTSWIFTSWIGSSWILLSWIMSSWINESWINGSWIPESWIRLSWISHSWOONSWOOPSWOPSSWORDSWORESWORNSWUNGSYLPHSYNCHSYNCSSYNODSYRUPTABBYTABLETABOOTABUSTACITTACKSTACKYTACOSTAFFYTAILSTAINTTAKENTAKERTAKESTALESTALKSTALLYTALONTAMEDTAMERTAMESTAMPSTANGOTANGSTANGYTANKSTANSYTAPEDTAPERTAPESTAPIRTARDYTAREDTARESTAROSTAROTTARPSTARRYTARTSTASERTASKSTASTETASTYTATTYTAUNTTAUPETAWNYTAXEDTAXESTAXISTEACHTEAKSTEALSTEAMSTEARSTEARYTEASETEATSTECHSTEEMSTEENSTEENYTEETHTELEXTELLSTEMPITEMPOTEMPSTEMPTTENDSTENETTENONTENORTENSETENTHTENTSTEPEETEPIDTERMSTERNSTERRYTERSETESTSTESTYTEXTSTHANKTHAWSTHEESTHEFTTHEIRTHEMETHERETHESETHETATHICKTHIEFTHIGHTHINETHINGTHINKTHINSTHIRDTHONGTHORNTHOSETHOUSTHREETHREWTHROBTHROETHROWTHRUMTHUDSTHUGSTHUMBTHUMPTHYMETHYMITIARATIBIATICKSTIDALTIDEDTIDESTIERSTIFFSTIGERTIGHTTIKESTILDETILEDTILESTILLSTILTSTIMEDTIMERTIMESTIMIDTINESTINGETINGSTINNYTINTSTIPISTIPSYTIREDTIRESTIROSTITANTITHETITLETIZZYTOADSTOADYTOASTTODAYTODDYTOFFYTOGAETOGASTOILSTOKEDTOKENTOKESTOLLSTOMBSTOMESTONALTONEDTONERTONESTONGSTONICTONNETOOLSTOOTHTOOTSTOPAZTOPICTOQUETORCHTORSITORSOTORTETORTSTORUSTOTALTOTEDTOTEMTOTESTOUCHTOUGHTOURSTOUTSTOWEDTOWELTOWERTOWNSTOXICTOXINTOYEDTRACETRACKTRACTTRADETRAILTRAINTRAITTRAMPTRAMSTRAPSTRASHTRAWLTRAYSTREADTREATTREEDTREESTREKSTRENDTRESSTRIADTRIALTRIBETRICETRICKTRIEDTRIESTRIKETRILLTRIMSTRIOSTRIPETRIPSTRITETROLLTROMPTROOPTROPETROTHTROTSTROUTTROYSTRUCETRUCKTRUEDTRUERTRUESTRULYTRUMPTRUNKTRUSSTRUSTTRUTHTRYSTTSARSTUBASTUBBYTUBEDTUBERTUBESTUCKSTUFTSTULIPTULLETUMIDTUMMYTUMORTUNASTUNEDTUNERTUNESTUNICTUNNYTURDSTURFSTURNSTUSKSTUTORTUTUSTUXESTWAINTWANGTWEAKTWEEDTWEETTWERKTWERPTWICETWIGSTWILLTWINETWINSTWIRLTWISTTWITSTYINGTYKESTYPEDTYPESTYPOSTYROSTZARSUDDERULCERULNAEULNASULTRAUMBELUMBERUMIAKUMPEDUNBARUNCLEUNCUTUNDERUNDIDUNDUEUNFITUNIFYUNIONUNITEUNITSUNITYUNMANUNPINUNSAYUNSETUNTIEUNTILUNWEDUNZIPUPENDUPPEDUPPERUPSETURBANURGEDURGESURINEUSAGEUSERSUSHERUSINGUSUALUSURPUSURYUTERIUTTERUVULAVACUAVAGUEVALESVALETVALIDVALORVALUEVALVEVAMPSVANESVAPEDVAPESVAPIDVAPORVASESVASTSVAULTVAUNTVEEPSVEERSVEGANVEILSVEINSVELDSVELDTVENALVENDSVENOMVENTSVENUEVERBSVERGEVERSEVERVEVESTSVETCHVEXEDVEXESVIALSVIANDVIBESVICARVICEDVICESVIDEOVIEWSVIGILVIGORVILERVILLAVINESVINYLVIOLAVIOLSVIPERVIRALVIREOVIRUSVISASVISEDVISESVISITVISORVISTAVITALVIVASVIVIDVIXENVIZORVOCALVODKAVOGUEVOICEVOIDSVOILEVOLESVOLTSVOMITVOTEDVOTERVOTESVOUCHVOWEDVOWELVULVAVYINGWACKOWACKSWACKYWADEDWADERWADESWADISWAFERWAFTSWAGEDWAGERWAGESWAGONWAIFSWAILSWAISTWAITSWAIVEWAKEDWAKENWAKESWALEDWALESWALKSWALLSWALTZWANDSWANEDWANESWANLYWANNAWANTSWARDSWARESWARMSWARNSWARPSWARTSWARTYWASPSWASTEWATCHWATERWATTSWAVEDWAVERWAVESWAXEDWAXENWAXESWEALSWEANSWEARSWEARYWEAVEWEDGEWEEDSWEEDYWEEKSWEEPSWEEPYWEESTWEFTSWEIGHWEIRDWEIRSWELCHWELDSWELLSWELSHWELTSWENCHWENDSWETLYWHACKWHALEWHAMSWHARFWHATSWHEALWHEATWHEELWHELKWHELPWHENSWHEREWHETSWHICHWHIFFWHILEWHIMSWHINEWHINYWHIPSWHIRLWHIRRWHIRSWHISKWHISTWHITEWHITSWHIZZWHOLEWHOOPWHOREWHORLWHOSEWICKSWIDENWIDERWIDOWWIDTHWIELDWIGHTWIKISWILDSWILEDWILESWILLSWILTSWIMPSWIMPYWINCEWINCHWINDSWINDYWINEDWINESWINGSWINKSWINOSWIPEDWIPERWIPESWIREDWIRESWISERWISESWISPSWISPYWITCHWITTYWIVESWIZESWOKENWOLFSWOMANWOMBSWOMENWOODSWOODYWOOEDWOOERWOOFSWOOLYWOOZYWORDSWORDYWORKSWORLDWORMSWORMYWORRYWORSEWORSTWORTHWOULDWOUNDWOVENWOWEDWRACKWRAPSWRAPTWRATHWREAKWRECKWRENSWRESTWRIERWRINGWRISTWRITEWRITSWRONGWROTEWROTHWRUNGWRYERWRYLYXENONXYLEMYACHTYACKSYAHOOYANKSYARDSYARNSYAWEDYAWLSYAWNSYEAHSYEARNYEARSYEASTYELLSYELPSYESESYIELDYOCKSYODELYOGINYOGISYOKEDYOKELYOKESYOLKSYOUNGYOURSYOUTHYOWLSYUCCAYUCKSYUCKYYUMMYYUPPYZEBRAZEBUSZEROSZESTSZILCHZINCSZINGSZIPPYZOMBIZONALZONEDZONESZOOMS";

const char words_list[] PROGMEM = {"ABACIABACKABAFTABASEABASHABATEABBEYABBOTABEAMABETSABHORABIDE"};


const char * words[] = {"asdfg"};

int LED = 0;

char the_word[6];
bool win = false;
int turn = 0;
int turn_max = 5;
int letter_count = 0;
char guess[5];

// Configure display
#define TFT_CS        10
#define TFT_RST        9
#define TFT_DC         8
Adafruit_ST7735 tft = Adafruit_ST7735(TFT_CS, TFT_DC, TFT_RST);
int letterBoxW = 16;
int letterBoxH = 16;



void pickWord() {
  // int i = random(1);
  // strcpy(the_word, words[i]);

  int size = sizeof(words_list) - 6;
  // Serial.println(size);
  int word_start = ((random(size) + 4)/5 * 5);
  // Serial.println(word_start);

  for (int i = 0; i < 5; i++) {
    the_word[i] = char(pgm_read_byte_near(words_list + word_start + i));
  }
  the_word[5] = '\0';
  Serial.print(the_word);

  Serial.println();

  return;
}

void drawGrid() {
  tft.drawRect(1, 1, letterBoxW, letterBoxH, ST7735_BLACK);
  tft.drawRect(18, 1, letterBoxW, letterBoxH, ST7735_BLACK);
  tft.drawRect(35, 1, letterBoxW, letterBoxH, ST7735_BLACK);
  tft.drawRect(52, 1, letterBoxW, letterBoxH, ST7735_BLACK);
  tft.drawRect(69, 1, letterBoxW, letterBoxH, ST7735_BLACK);

  tft.drawRect(1, 18, letterBoxW, letterBoxH, ST7735_BLACK);
  tft.drawRect(18, 18, letterBoxW, letterBoxH, ST7735_BLACK);
  tft.drawRect(35, 18, letterBoxW, letterBoxH, ST7735_BLACK);
  tft.drawRect(52, 18, letterBoxW, letterBoxH, ST7735_BLACK);
  tft.drawRect(69, 18, letterBoxW, letterBoxH, ST7735_BLACK);

  tft.drawRect(1, 35, letterBoxW, letterBoxH, ST7735_BLACK);
  tft.drawRect(18, 35, letterBoxW, letterBoxH, ST7735_BLACK);
  tft.drawRect(35, 35, letterBoxW, letterBoxH, ST7735_BLACK);
  tft.drawRect(52, 35, letterBoxW, letterBoxH, ST7735_BLACK);
  tft.drawRect(69, 35, letterBoxW, letterBoxH, ST7735_BLACK);

  tft.drawRect(1, 52, letterBoxW, letterBoxH, ST7735_BLACK);
  tft.drawRect(18, 52, letterBoxW, letterBoxH, ST7735_BLACK);
  tft.drawRect(35, 52, letterBoxW, letterBoxH, ST7735_BLACK);
  tft.drawRect(52, 52, letterBoxW, letterBoxH, ST7735_BLACK);
  tft.drawRect(69, 52, letterBoxW, letterBoxH, ST7735_BLACK);

  tft.drawRect(1, 69, letterBoxW, letterBoxH, ST7735_BLACK);
  tft.drawRect(18, 69, letterBoxW, letterBoxH, ST7735_BLACK);
  tft.drawRect(35, 69, letterBoxW, letterBoxH, ST7735_BLACK);
  tft.drawRect(52, 69, letterBoxW, letterBoxH, ST7735_BLACK);
  tft.drawRect(69, 69, letterBoxW, letterBoxH, ST7735_BLACK);

  tft.drawRect(1, 86, letterBoxW, letterBoxH, ST7735_BLACK);
  tft.drawRect(18, 86, letterBoxW, letterBoxH, ST7735_BLACK);
  tft.drawRect(35, 86, letterBoxW, letterBoxH, ST7735_BLACK);
  tft.drawRect(52, 86, letterBoxW, letterBoxH, ST7735_BLACK);
  tft.drawRect(69, 86, letterBoxW, letterBoxH, ST7735_BLACK);

}

void setup() {
  Serial.begin(9600); // Initialize the Serial port
  randomSeed(analogRead(A0)); // Initialize random seed for picking word
  pinMode(LED, HIGH); // Set the LED pin to output
  tft.initR(INITR_144GREENTAB);
  tft.fillScreen(ST7735_WHITE);
  tft.setRotation(1);
  drawGrid();
  tft.setFont(&FreeMonoBold9pt7b);
  tft.setTextColor(ST7735_BLACK, ST7735_WHITE);
  tft.setCursor(4, 14);
  tft.println("W");
  tft.setCursor(4, 31);
  tft.println("O");
  tft.setCursor(4, 48);
  tft.println("R");
  tft.setCursor(4, 65);
  tft.println("D");
  tft.setCursor(4, 82);
  tft.println("L");
  tft.setCursor(4, 99);
  tft.println("E");

  while(!Serial) {} // Wait for Serial port to be ready

  pickWord(); // Pick random word

  
}

void loop() {

  if (Serial.available() > 0) {
    char input = byte(Serial.read()); // Get a single keyboard entry

    // Print letter if less than 5 are present, but not enter key.
    // Only allow letters.
    if (letter_count < 5 && isAlpha(input) && input != '\n') {
      char letter = input & ~(0x20); // Convert letter to uppercase
      Serial.print(letter);
      guess[letter_count] = letter;

      letter_count++;
      digitalWrite(LED, HIGH);
      delay(50);
      digitalWrite(LED, LOW);
    }
    
    // Enter key submits guess if 5 letters are present.
    if (letter_count == 5 && input == '\n') {
      letter_count = 0;
      Serial.println();
      Serial.println("######");
      Serial.println(the_word);
      Serial.println();
      Serial.println(guess);
      Serial.println("######");
      if (turn < turn_max && strcmp(the_word, guess) == 0) { // Win
        win = true;
        Serial.println("You won!");
      }
      else { // Check letters
        for (size_t i = 0; i < sizeof(guess); i++) {
            char * pch;
            pch = strchr(the_word, guess[i]);
            if (pch != NULL) {
              Serial.println(guess[i]);
              Serial.println(pch - the_word);
            }
        }
      }
      if (turn == turn_max) { // Lose
        Serial.println(the_word);
      }
      turn++;
    }

  }

}